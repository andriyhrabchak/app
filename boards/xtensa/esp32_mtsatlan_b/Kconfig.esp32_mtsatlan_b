## boards/xtensa/esp32_mtsatlan_b/Kconfig.esp32_mtsatlan_b
```kconfig
# ESP32-MTSATLAN-B board configuration

# Copyright (c) 2022 Grant Ramsay <grant.ramsay@hotmail.com>
# SPDX-License-Identifier: Apache-2.0

config BOARD_ESP32_MTSATLAN_B
	select SOC_ESP32_WROOM_32UE_N8
	select SOC_ESP32_PROCPU if BOARD_ESP32_MTSATLAN_B_ESP32_PROCPU
	select SOC_ESP32_APPCPU if BOARD_ESP32_MTSATLAN_B_ESP32_APPCPU
```

## boards/xtensa/esp32_mtsatlan_b/esp32_mtsatlan_b_procpu_defconfig
```kconfig
# SPDX-License-Identifier: Apache-2.0

CONFIG_MAIN_STACK_SIZE=8192

CONFIG_CONSOLE=y
CONFIG_SERIAL=y
CONFIG_UART_CONSOLE=y
CONFIG_UART_INTERRUPT_DRIVEN=y
CONFIG_UART_LINE_CTRL=n
CONFIG_ETH_ESP32=y
CONFIG_SPI=y
CONFIG_I2C=y
CONFIG_I2C_INIT_PRIORITY=39
CONFIG_GPIO=y
CONFIG_GPIO_PCF8574T=y
CONFIG_GPIO_PCF8574T_INIT_PRIORITY=39
CONFIG_RTC=y
CONFIG_RTC_RV3032=y
CONFIG_POSIX_TIMERS=y
```

## defconfig
```kconfig
CONFIG_NET_L2_ETHERNET=y
# CONFIG_NET_IPV6 is not set
CONFIG_MAIN_STACK_SIZE=8192
CONFIG_FLASH=y
CONFIG_HEAP_MEM_POOL_SIZE=16384
CONFIG_GPIO=y
CONFIG_REBOOT=y
CONFIG_CONSOLE=y
CONFIG_ZCBOR=y
CONFIG_GPIO_PCF8574T_INIT_PRIORITY=39
CONFIG_BOOTLOADER_MCUBOOT=y
CONFIG_MPU_ALLOW_FLASH_WRITE=y
CONFIG_UART_CONSOLE=y
CONFIG_UART_MCUMGR=y
CONFIG_GPIO_SHELL=y
CONFIG_HWINFO=y
CONFIG_I2C_SHELL=y
CONFIG_I2C_INIT_PRIORITY=39
CONFIG_RTC=y
CONFIG_RTC_SHELL=y
CONFIG_POSIX_TIMERS=y
CONFIG_BASE64=y
CONFIG_IMG_MANAGER=y
CONFIG_MCUBOOT_SHELL=y
CONFIG_MCUBOOT_UPDATE_FOOTER_SIZE=0x1000
CONFIG_FILE_SYSTEM=y
CONFIG_FILE_SYSTEM_SHELL=y
CONFIG_FILE_SYSTEM_SHELL_TEST_COMMANDS=y
CONFIG_FILE_SYSTEM_MKFS=y
CONFIG_FAT_FILESYSTEM_ELM=y
CONFIG_FS_FATFS_NUM_FILES=6
CONFIG_FS_FATFS_LFN=y
CONFIG_FILE_SYSTEM_LITTLEFS=y
CONFIG_LOG_BACKEND_NET=y
CONFIG_LOG_BACKEND_NET_RFC5424_STRUCTURED_DATA=y
CONFIG_LOG_BACKEND_NET_RFC5424_SDATA_SOFTWARE=y
CONFIG_LOG_BACKEND_NET_RFC5424_SDATA_SOFTWARE_VERSION=y
CONFIG_LOG_BACKEND_NET_RFC5424_SDATA_SEQID=y
CONFIG_LOG_BACKEND_NET_RFC5424_SDATA_UPTIME=y
CONFIG_LOG_BACKEND_NET_SERVER="192.168.137.1:514"
CONFIG_LOG_CMDS=y
CONFIG_MCUMGR=y
CONFIG_MCUMGR_GRP_IMG=y
CONFIG_MCUMGR_TRANSPORT_SHELL=y
CONFIG_MODBUS=y
CONFIG_MODBUS_ROLE_CLIENT=y
CONFIG_MODBUS_RAW_ADU=y
CONFIG_MODBUS_NUMOF_RAW_ADU=1
# CONFIG_MODBUS_FP_EXTENSIONS is not set
CONFIG_NETWORKING=y
CONFIG_NET_OFFLOAD=y
CONFIG_NET_IPV4=y
CONFIG_NET_SHELL=y
CONFIG_NET_LOG=y
CONFIG_DNS_RESOLVER=y
CONFIG_DNS_SERVER_IP_ADDRESSES=y
CONFIG_DNS_SERVER1="8.8.8.8"
CONFIG_SNTP=y
CONFIG_NET_CONFIG_SETTINGS=y
CONFIG_NET_DHCPV4=y
CONFIG_SHELL_BACKEND_SERIAL_TX_RING_BUFFER_SIZE=256
CONFIG_SHELL_BACKEND_SERIAL_RX_RING_BUFFER_SIZE=4096
CONFIG_SHELL_STACK_SIZE=4096
CONFIG_SHELL_ARGC_MAX=255
CONFIG_STATS=y
CONFIG_STATS_NAMES=y
CONFIG_FLASH_MAP=y
CONFIG_STREAM_FLASH=y
CONFIG_ROM_END_OFFSET=0x1000
```

## drivers/gpio/Kconfig
```kconfig
# PCF857x GPIO configuration options

# Copyright (c) 2022 Ithinx
# Copyright (c) 2023 Mr Beam Lasers GmbH
# Copyright (c) 2023 Amrith Venkat Kesavamoorthi <amrith@mr-beam.org>
# Copyright (c) 2024 HAV
# SPDX-License-Identifier: Apache-2.0

config GPIO_PCF8574T
	bool "PCF8574T I2C GPIO chip"
	default y
	depends on DT_HAS_NXP_PCF8574T_ENABLED
	select I2C
	help
	  Enable driver for PCF8574T I2C GPIO chip.


config GPIO_PCF8574T_INIT_PRIORITY
  int "Init priority"
  default 70
  depends on GPIO_PCF8574T
  help
    Device driver initialization priority.
```

## drivers/rtc/Kconfig
```kconfig
# RV3032 RTC configuration options
# Copyright (c) 2024 ANITRA system s.r.o.
# Copyright (c) 2024 HAV
# SPDX-License-Identifier: Apache-2.0

config RTC_RV3032
	bool "Micro Crystal RV3032 I2C DTCXO Temp. Compensated Real-Time Clock Module driver"
	default y
	depends on DT_HAS_MICROCRYSTAL_RV3032_ENABLED
	select I2C
	help
	  Enable the Micro Crystal RV3032 I2C RTC driver.
```
